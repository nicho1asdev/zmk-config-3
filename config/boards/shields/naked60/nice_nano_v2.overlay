

#include <dt-bindings/led/led.h>

/ {
    chosen {
        zmk,underglow = &led_strip;
    };
};

/ {
    led_strip: ws2812_pio {
        compatible   = "zmk,ws2812-pio";
        gpios        = <&gpio1 7 GPIO_ACTIVE_HIGH>;
        chain-length = <68>;
    };
};