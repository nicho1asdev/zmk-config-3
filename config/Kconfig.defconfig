## config/Kconfig.defconfig
```kconfig
if SHIELD_NAKED60

config ZMK_KEYBOARD_NAME
    default "Viera Keyboard"

config ZMK_BLE
    default y

config ZMK_USB
    default y

config ZMK_RGB_UNDERGLOW
    bool
    default y
config ZMK_RGB_UNDERGLOW_LED_COUNT
    int
    default 68
config ZMK_RGB_UNDERGLOW_ON_START
    bool
    default n
endif
```

## config/boards/shields/dac_man_5x6/Kconfig.defconfig
```kconfig
if SHIELD_VIERA

config ZMK_KEYBOARD_NAME
    default "Viera Keyboard"

config ZMK_BLE
    default n

CONFIG_USB
    default y
endif
```

## config/boards/shields/naked60/Kconfig.defconfig
```kconfig
if SHIELD_NAKED60

config ZMK_KEYBOARD_NAME
    default "Viera Keyboard"

config ZMK_BLE
    default y

config ZMK_USB
    default y

config ZMK_RGB_UNDERGLOW
    default y

config ZMK_RGB_UNDERGLOW_LED_COUNT
    default 10

config ZMK_RGB_UNDERGLOW_GPIO_PIN
    default 7

config ZMK_RGB_UNDERGLOW_GPIO_CONTROLLER
    default "GPIO_0"
endif
```

## config/west.yml
```yaml
manifest:
  remotes:
    - name: nicho
      url-base: https://github.com/nicho1asdev
  projects:
    - name: zmk
      remote: nicho
      revision: custom-effects
      import: app/west.yml
  self:
    path: config
```
